## CMakeLists.txt
```
cmake_minimum_required(VERSION 3.20.0)

find_package(Zephyr REQUIRED HINTS $ENV{ZEPHYR_BASE})
project(interrupt)
FILE(GLOB app_sources src/*.c)
target_sources(app PRIVATE src/main.c)
```

## prj.conf
```kconfig
CONFIG_GPIO=y
CONFIG_SHELL=y
CONFIG_SERIAL=y

CONFIG_CONSOLE_INPUT_MAX_LINE_LEN=128
CONFIG_CONSOLE_HANDLER=y
CONFIG_DEBUG=y

CONFIG_DYNAMIC_INTERRUPTS=y
CONFIG_ZERO_LATENCY_IRQS=y
```

## src/main.c
```c
#include <zephyr/kernel.h>
#include <zephyr/sys/printk.h>
#include <zephyr/device.h>
#include "interrupt_util.h"

#include <inttypes.h>


#define SENSOR_IRQ 25 // Số IRQ của cảm biến

volatile int sensor_value = 0;

void sensor_read(void)
{
    // Đọc giá trị từ cảm biến và lưu vào sensor_value
    // (Giả sử rằng giá trị được đọc từ cảm biến được lưu vào biến sensor_value)
    sensor_value = sensor_value + 20; 
}

void sensor_isr(const struct device *dev, void *data)
{
    // Xử lý ngắt từ cảm biến
            printk("Warning: Sensor value exceeded 100! at %" PRIu32 "\n", k_cycle_get_32());
             sensor_value = 0;

}

void sensor_isr_installer(void)
{
    // Kết nối ngắt và kích hoạt ngắt
    IRQ_CONNECT(SENSOR_IRQ, 0, sensor_isr, NULL, IRQ_ZERO_LATENCY);
    irq_enable(SENSOR_IRQ);
}

void main(void)
{
    sensor_isr_installer();

    while (1) {
        // Đọc giá trị từ cảm biến mỗi 10 giây
        sensor_read();
        printk("%d at %" PRIu32 "\n",sensor_value, k_cycle_get_32());
    if (sensor_value >= 100) {

       trigger_irq(SENSOR_IRQ);
    }
        
        k_sleep(K_SECONDS(1));
    }
}
```
